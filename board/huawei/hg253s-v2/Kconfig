## board/huawei/hg253s-v2/Kconfig
```kconfig
if BOARD_HUAWEI_HG253S_V2

config SYS_BOARD
	default "hg253s-v2"

config SYS_VENDOR
	default "huawei"

config SYS_CONFIG_NAME
	default "huawei_hg253s-v2"

endif
```

## board/sercomm/ad1018/Kconfig
```kconfig
if BOARD_SERCOMM_AD1018

config SYS_BOARD
	default "ad1018"

config SYS_VENDOR
	default "sercomm"

config SYS_CONFIG_NAME
	default "sercomm_ad1018"

endif
```
